## app/sample.yaml
```yaml
sample:
  description: Temperature Control Application
  name: temperature-control-application 
common:
  build_only: true
  integration_platforms:
    - native_sim
    - blackpill_f411ce
tests:
  app.default: {}
  app.debug:
    extra_overlay_confs:
      - debug.conf
```

## dts/bindings/sensor/zephyr,fan-taco.yaml
```yaml
description: |
  Emulated driver for a fan taco

compatible: "zephyr,fan-taco"

include: base.yaml
```

## lib/adc_compensation/Kconfig
```kconfig
config ADC_COMP
	bool "Support for adc compensation library"
	help
	  This option enables the 'ADC_COMP' library
```

## west.yml
```yaml
manifest:
  remotes:
    - name: zephyrproject-rtos
      url-base: https://github.com/zephyrproject-rtos

  projects:
    - name: zephyr
      remote: zephyrproject-rtos
      revision: main
      import:
        name-allowlist:
          - cmsis_6    # required by the ARM port for Cortex-M
          - hal_stm32  # required by the nucleo_f302r8 board (STM32 based)
```
