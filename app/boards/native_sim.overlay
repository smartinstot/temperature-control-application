/ {
	chosen {
		zephyr,selected_adc = &adc0;
	};

    adc0: adc {
        compatible = "zephyr,adc-emul";
        #io-channel-cells = <1>;
        status = "okay";
    
   	    #address-cells = <1>;
	    #size-cells = <0>;
 
        ref-internal-mv = <3300>;
        ref-external1-mv = <5000>;
        channel@0 {
            reg = <0>;
            zephyr,gain = "ADC_GAIN_1";
            zephyr,reference = "ADC_REF_INTERNAL";
            zephyr,acquisition-time = <ADC_ACQ_TIME_DEFAULT>;
            zephyr,resolution = <12>;
        };
    
    };
};
